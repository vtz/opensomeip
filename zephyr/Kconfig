## zephyr/Kconfig
```kconfig
################################################################################
# Copyright (c) 2025 Vinicius Tadeu Zein
#
# SPDX-License-Identifier: Apache-2.0
################################################################################

menuconfig SOMEIP
	bool "SOME/IP Protocol Stack"
	default n
	depends on CPP
	help
	  Enable the SOME/IP protocol stack for automotive Ethernet communication.

if SOMEIP

config SOMEIP_TRANSPORT_UDP
	bool "UDP Transport"
	default y
	depends on NET_SOCKETS
	help
	  Enable SOME/IP UDP transport.

config SOMEIP_TRANSPORT_TCP
	bool "TCP Transport"
	default y
	depends on NET_SOCKETS
	help
	  Enable SOME/IP TCP transport.

config SOMEIP_SD
	bool "Service Discovery"
	default y
	depends on SOMEIP_TRANSPORT_UDP
	help
	  Enable SOME/IP Service Discovery (SD).

config SOMEIP_RPC
	bool "Remote Procedure Call"
	default y
	depends on SOMEIP_TRANSPORT_UDP || SOMEIP_TRANSPORT_TCP
	help
	  Enable SOME/IP RPC client and server.

config SOMEIP_EVENTS
	bool "Event handling"
	default y
	depends on SOMEIP_TRANSPORT_UDP || SOMEIP_TRANSPORT_TCP
	help
	  Enable SOME/IP event publisher and subscriber.

config SOMEIP_E2E
	bool "End-to-End Protection"
	default y
	help
	  Enable SOME/IP E2E (End-to-End) protection profiles.

config SOMEIP_TP
	bool "Transport Protocol (segmentation)"
	default y
	depends on SOMEIP_TRANSPORT_UDP || SOMEIP_TRANSPORT_TCP
	help
	  Enable SOME/IP-TP message segmentation and reassembly.

config SOMEIP_THREAD_STACK_SIZE
	int "Thread stack size (bytes)"
	default 4096
	range 512 65536
	help
	  Stack size for SOME/IP worker threads on embedded targets.

config SOMEIP_MESSAGE_POOL_SIZE
	int "Pre-allocated message pool size"
	default 16
	range 1 1024
	help
	  Number of pre-allocated Message objects for embedded targets.

config SOMEIP_MAX_PAYLOAD_SIZE
	int "Maximum payload size (bytes)"
	default 1400
	range 1 65535
	help
	  Maximum SOME/IP payload size. Set to 1400 to avoid IP fragmentation
	  on standard Ethernet. Larger values require SOME/IP-TP.

config SOMEIP_MAX_SUBSCRIPTIONS
	int "Maximum event subscriptions"
	default 8
	range 1 255
	help
	  Maximum number of concurrent event subscriptions.

config SOMEIP_MAX_PENDING_CALLS
	int "Maximum pending RPC calls"
	default 8
	range 1 255
	help
	  Maximum number of pending RPC calls waiting for response.

endif # SOMEIP
```

## zephyr/boards/mr_canhubk3.conf
```kconfig
# NXP S32K344 (mr_canhubk3) configuration -- 320KB RAM
CONFIG_HEAP_MEM_POOL_SIZE=65536
CONFIG_SOMEIP_MESSAGE_POOL_SIZE=8
CONFIG_SOMEIP_MAX_PAYLOAD_SIZE=1400
CONFIG_SOMEIP_MAX_SUBSCRIPTIONS=4
CONFIG_SOMEIP_MAX_PENDING_CALLS=4
CONFIG_SOMEIP_THREAD_STACK_SIZE=2048

# Disable optional features to save memory
CONFIG_SOMEIP_TRANSPORT_TCP=n
CONFIG_SOMEIP_E2E=n
```

## zephyr/boards/native_sim.conf
```kconfig
# native_sim-specific configuration
CONFIG_HEAP_MEM_POOL_SIZE=262144
CONFIG_SOMEIP_MESSAGE_POOL_SIZE=32
CONFIG_SOMEIP_MAX_PAYLOAD_SIZE=65535

CONFIG_NET_CONFIG_SETTINGS=y
CONFIG_NET_CONFIG_NEED_IPV4=y
CONFIG_NET_CONFIG_MY_IPV4_ADDR="192.0.2.1"
CONFIG_NET_CONFIG_PEER_IPV4_ADDR="192.0.2.2"

CONFIG_NET_LOG_LEVEL_INF=y
```

## zephyr/boards/native_sim_asan.conf
```kconfig
# ASan + UBSan overlay for native_sim memory diagnostics
# Applied on top of native_sim.conf when building with sanitizers
CONFIG_ASAN=y
CONFIG_UBSAN=y
CONFIG_HEAP_MEM_POOL_SIZE=524288
```

## zephyr/boards/s32k388_renode/Kconfig.s32k388_renode
```kconfig
# Copyright (c) 2025 Vinicius Tadeu Zein
# SPDX-License-Identifier: Apache-2.0

config BOARD_S32K388_RENODE
	select SOC_S32K388
```

## zephyr/boards/s32k388_renode/board.yml
```yaml
board:
  name: s32k388_renode
  vendor: nxp
  socs:
    - name: s32k388
  full_name: NXP S32K388 (Renode simulation)
```

## zephyr/boards/s32k388_renode/s32k388_renode_defconfig
```kconfig
CONFIG_FPU=y
CONFIG_CONSOLE=y
CONFIG_UART_CONSOLE=y
CONFIG_SERIAL=y
CONFIG_CLOCK_CONTROL=n
CONFIG_SYS_CLOCK_HW_CYCLES_PER_SEC=160000000
```

## zephyr/soc/s32k388/Kconfig
```kconfig
config SOC_S32K388
	select ARM
	select CPU_CORTEX_M7
	select CPU_CORTEX_M_HAS_SYSTICK
	select CPU_HAS_FPU
	select CPU_HAS_ARM_MPU
```

## zephyr/soc/s32k388/Kconfig.defconfig
```kconfig
if SOC_S32K388

config SOC
	default "s32k388"

config NUM_IRQS
	default 240

config SYS_CLOCK_HW_CYCLES_PER_SEC
	default 160000000

endif # SOC_S32K388
```
