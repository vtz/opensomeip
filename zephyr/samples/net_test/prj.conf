## CMakeLists.txt
```
cmake_minimum_required(VERSION 3.20.0)
find_package(Zephyr REQUIRED HINTS $ENV{ZEPHYR_BASE})
project(net_test)

target_sources(app PRIVATE src/main.cpp)
```

## prj.conf
```kconfig
CONFIG_CPP=y
CONFIG_STD_CPP17=y
CONFIG_REQUIRES_FULL_LIBCPP=y

CONFIG_NETWORKING=y
CONFIG_NET_IPV4=y
CONFIG_NET_UDP=y
CONFIG_NET_SOCKETS=y

CONFIG_POSIX_API=y

CONFIG_NET_CONFIG_SETTINGS=y
CONFIG_NET_CONFIG_NEED_IPV4=y
CONFIG_NET_CONFIG_MY_IPV4_ADDR="192.0.2.1"
CONFIG_NET_CONFIG_PEER_IPV4_ADDR="192.0.2.2"

CONFIG_NET_LOG_LEVEL_INF=y
CONFIG_NET_SHELL=y

CONFIG_NET_IF_UNICAST_IPV4_ADDR_COUNT=3
CONFIG_NET_IF_MCAST_IPV4_ADDR_COUNT=2
CONFIG_NET_MAX_CONTEXTS=10
CONFIG_NET_BUF_RX_COUNT=16
CONFIG_NET_BUF_TX_COUNT=16
CONFIG_NET_PKT_RX_COUNT=8
CONFIG_NET_PKT_TX_COUNT=8

CONFIG_HEAP_MEM_POOL_SIZE=131072
CONFIG_MAIN_STACK_SIZE=4096
```

## src/main.cpp
```c
/********************************************************************************
 * Copyright (c) 2025 Vinicius Tadeu Zein
 *
 * SPDX-License-Identifier: Apache-2.0
 ********************************************************************************/

#include <cstdio>
#include <cstring>
#include <cerrno>

#include <sys/socket.h>
#include <netinet/in.h>
#include <arpa/inet.h>
#include <unistd.h>

static constexpr int ECHO_PORT = 4242;
static constexpr int BUF_SIZE = 256;

int main() {
    printf("=== SOME/IP Zephyr Network Test ===\n");
    printf("UDP echo server starting on port %d...\n", ECHO_PORT);

    int sock = socket(AF_INET, SOCK_DGRAM, IPPROTO_UDP);
    if (sock < 0) {
        printf("ERROR: socket() failed: %d\n", errno);
        return 1;
    }

    sockaddr_in bind_addr{};
    bind_addr.sin_family = AF_INET;
    bind_addr.sin_port = htons(ECHO_PORT);
    bind_addr.sin_addr.s_addr = htonl(INADDR_ANY);

    if (bind(sock, reinterpret_cast<sockaddr*>(&bind_addr), sizeof(bind_addr)) < 0) {
        printf("ERROR: bind() failed: %d\n", errno);
        close(sock);
        return 1;
    }

    printf("Listening for UDP packets...\n");

    char buf[BUF_SIZE];
    sockaddr_in client_addr{};
    socklen_t client_len = sizeof(client_addr);

    for (int i = 0; i < 5; ++i) {
        ssize_t received = recvfrom(sock, buf, sizeof(buf) - 1, 0,
                                    reinterpret_cast<sockaddr*>(&client_addr),
                                    &client_len);
        if (received < 0) {
            printf("ERROR: recvfrom() failed: %d\n", errno);
            break;
        }

        buf[received] = '\0';
        char addr_str[INET_ADDRSTRLEN];
        inet_ntop(AF_INET, &client_addr.sin_addr, addr_str, sizeof(addr_str));
        printf("Received %zd bytes from %s:%d: %s\n",
               received, addr_str, ntohs(client_addr.sin_port), buf);

        ssize_t sent = sendto(sock, buf, received, 0,
                              reinterpret_cast<sockaddr*>(&client_addr),
                              client_len);
        if (sent < 0) {
            printf("ERROR: sendto() failed: %d\n", errno);
            break;
        }
        printf("Echoed %zd bytes back\n", sent);
    }

    close(sock);
    printf("=== Network test complete ===\n");
    return 0;
}
```
