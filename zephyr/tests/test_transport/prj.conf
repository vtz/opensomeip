## CMakeLists.txt
```
cmake_minimum_required(VERSION 3.20.0)

set(SOMEIP_ROOT ${CMAKE_CURRENT_LIST_DIR}/../../..)
list(APPEND ZEPHYR_EXTRA_MODULES ${SOMEIP_ROOT})

find_package(Zephyr REQUIRED HINTS $ENV{ZEPHYR_BASE})
project(test_transport)

target_sources(app PRIVATE src/main.cpp)
```

## prj.conf
```kconfig
CONFIG_CPP=y
CONFIG_STD_CPP17=y
CONFIG_REQUIRES_FULL_LIBCPP=y
CONFIG_POSIX_API=y

CONFIG_NETWORKING=y
CONFIG_NET_IPV4=y
CONFIG_NET_UDP=y
CONFIG_NET_SOCKETS=y
CONFIG_NET_CONFIG_SETTINGS=y
CONFIG_NET_CONFIG_NEED_IPV4=y
CONFIG_NET_CONFIG_MY_IPV4_ADDR="192.0.2.1"
CONFIG_NET_CONFIG_PEER_IPV4_ADDR="192.0.2.2"

CONFIG_HEAP_MEM_POOL_SIZE=131072
CONFIG_MAIN_STACK_SIZE=8192

CONFIG_SOMEIP=y
CONFIG_SOMEIP_TRANSPORT_UDP=y
CONFIG_SOMEIP_TRANSPORT_TCP=n
CONFIG_SOMEIP_SD=n
CONFIG_SOMEIP_RPC=n
CONFIG_SOMEIP_EVENTS=n
CONFIG_SOMEIP_E2E=n
CONFIG_SOMEIP_TP=n
```

## src/main.cpp
```c
/********************************************************************************
 * Copyright (c) 2025 Vinicius Tadeu Zein
 *
 * SPDX-License-Identifier: Apache-2.0
 ********************************************************************************/

/**
 * UDP transport test for Zephyr.
 *
 * Creates a UDP socket, sends a SOME/IP message to localhost,
 * receives the echo, and validates the round-trip.
 * Designed for native_sim with TAP networking.
 */

#include <cstdio>
#include <cstring>
#include <chrono>
#include <atomic>

#include "someip/message.h"
#include "someip/types.h"
#include "common/result.h"
#include "transport/endpoint.h"
#include "transport/udp_transport.h"
#include "platform/thread.h"

using namespace someip;
using namespace someip::transport;

static int tests_passed = 0;
static int tests_failed = 0;

#define CHECK(cond, name)                                   \
    do {                                                    \
        if (cond) {                                         \
            printf("  [PASS] %s\n", name);                  \
            tests_passed++;                                 \
        } else {                                            \
            printf("  [FAIL] %s\n", name);                  \
            tests_failed++;                                 \
        }                                                   \
    } while (0)

static void test_udp_loopback() {
    printf("\n--- UDP Loopback Test ---\n");

    // Bind to INADDR_ANY to avoid interface-specific bind failures on native_sim.
    Endpoint server_ep("0.0.0.0", 0);
    UdpTransportConfig config;
    // Non-blocking mode avoids native_sim shutdown hangs in receive_loop.
    config.blocking = false;

    UdpTransport server(server_ep, config);
    auto result = server.start();
    CHECK(result == Result::SUCCESS, "server_start");
    if (result != Result::SUCCESS) return;

    auto bound_ep = server.get_local_endpoint();
    Endpoint server_target("127.0.0.1", bound_ep.get_port());
    printf("  Server bound to port %d\n", bound_ep.get_port());

    Message msg(MessageId(0xABCD, 0x0001),
                RequestId(0x0001, 0x0001),
                MessageType::REQUEST,
                ReturnCode::E_OK);
    msg.set_payload({0x01, 0x02, 0x03});

    Endpoint client_ep("0.0.0.0", 0);
    UdpTransport client(client_ep, config);
    result = client.start();
    CHECK(result == Result::SUCCESS, "client_start");
    if (result != Result::SUCCESS) return;

    result = client.send_message(msg, server_target);
    CHECK(result == Result::SUCCESS, "send_message");

    MessagePtr received = nullptr;
    for (int attempt = 0; attempt < 50; ++attempt) {
        platform::this_thread::sleep_for(std::chrono::milliseconds(10));
        received = server.receive_message();
        if (received) break;
    }
    CHECK(received != nullptr, "receive_message");

    if (received) {
        CHECK(received->get_service_id() == 0xABCD, "service_id_match");
        CHECK(received->get_payload().size() == 3, "payload_size_match");
    }

    client.stop();
    server.stop();
}

int main() {
    printf("=== SOME/IP Transport Tests on Zephyr ===\n");

    test_udp_loopback();

    printf("\n=== Results: %d passed, %d failed ===\n",
           tests_passed, tests_failed);

    return tests_failed > 0 ? 1 : 0;
}
```
